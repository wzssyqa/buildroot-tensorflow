## package/abseil/Config.in
```kconfig
config BR2_PACKAGE_ABSEIL
	bool "Abseil"
	depends on BR2_INSTALL_LIBSTDCPP
	help
	  Abseil is an open-source collection of C++ code (compliant to C++11)
          designed to augment the C++ standard library.

	  https://github.com/abseil/abseil-cpp

comment "abseil needs a toolchain w/ C++"
	depends on !BR2_INSTALL_LIBSTDCPP
```

## package/double-conversion/Config.in
```kconfig
config BR2_PACKAGE_DOUBLE_CONVERSION
	bool "binary-decimal and decimal-binary conversion routines"
	depends on BR2_TOOLCHAIN_GCC_AT_LEAST_4_7 # C++11
	depends on BR2_INSTALL_LIBSTDCPP
	help
	  Provides binary-decimal and decimal-binary routines for IEEE doubles.

	  the library consists of efficient conversion routines
	  that have been extracted from the V8 JavaScript engine.
	  The code has been refactored and improved so that 
	  it can be used more easily in other projects.
```

## package/fft2d/Config.in
```kconfig
config BR2_PACKAGE_FFT2D
	bool "fft2d"
	help
	  General Purpose FFT (Fast Fourier/Cosine/Sine Transform) Package
	  A package to calculate Discrete Fourier/Cosine/Sine Transforms of 
	  1-dimensional sequences of length 2^N.

	  http://www.darwinsys.com/file/
```

## package/gemmlowp/Config.in
```kconfig
config BR2_PACKAGE_GEMMLOWP
	bool "gemmlowp"
	depends on BR2_INSTALL_LIBSTDCPP
	help
	  gemmlowp: a small self-contained low-precision GEMM library.
          This is not a full linear algebra library, only a GEMM library:
          it only does general matrix multiplication ("GEMM").

          https://github.com/google/gemmlowp

comment "gemmlowp needs a toolchain w/ C++"
	depends on !BR2_INSTALL_LIBSTDCPP
```

## package/grpc/Config.in
```kconfig
config BR2_PACKAGE_GRPC
	bool "gRPC - An RPC library and framework"
	depends on BR2_TOOLCHAIN_GCC_AT_LEAST_4_7 # C++11
	depends on BR2_INSTALL_LIBSTDCPP
	select BR2_PACKAGE_PROTBUF
	select BR2_PACKAGE_C_ARES
	select BR2_PACKAGE_ZLIB
	select BR2_PACKAGE_OPENSSL
	select BR2_PACKAGE_GFLAGS
	help
	  gRPC is a modern, open source, high-performance remote procedure call (RPC)
	  framework that can run anywhere. 
	  It enables client and server applications to communicate transparently,
	  and makes it easier to build connected systems.

	  https://grpc.io/
```

## package/neon2sse/Config.in
```kconfig
config BR2_PACKAGE_NEON2SSE
	bool "ARM_NEON_2_x86_SSE"
	help
	  NEON_2_SSE.h file is intended to simplify ARM->IA32 porting.

	  https://github.com/intel/ARM_NEON_2_x86_SSE
```

## package/nsync/Config.in
```kconfig
config BR2_PACKAGE_NSYNC
	bool "C library that exports various synchronization primitives"
	depends on BR2_TOOLCHAIN_GCC_AT_LEAST_4_7 # C++11
	depends on BR2_INSTALL_LIBSTDCPP
	help
          nsync is a C library that exports various synchronization primitives:
	  locks
	  condition variables
	  run-once initialization
	  waitable counter (useful for barriers)
	  waitable bit (useful for cancellation, or other conditions)

	  https://github.com/google/nsync
```

## package/prototext/Config.in
```kconfig
config BR2_PACKAGE_PROTOTEXT
	bool "proto text executable"
	depends on BR2_INSTALL_LIBSTDCPP
	depends on BR2_PACKAGE_ABSEIL
	depends on BR2_PACKAGE_EIGEN
	depends on BR2_PACKAGE_ZLIB
	help
          provides build-time generation of proto3 text format functions

	  https://github.com/tensorflow/tensorflow/tree/master/tensorflow/tools/proto_text  
```

## package/re2/Config.in
```kconfig
config BR2_PACKAGE_RE2
	bool "google re2"
	help
	  a regular expression library

	  https://github.com/google/re2
```

## package/tensorflow-lite/Config.in
```kconfig
config BR2_PACKAGE_TENSORFLOW_LITE
	bool "TensorFlow Lite"
	depends on BR2_PACKAGE_EIGEN
	depends on BR2_PACKAGE_GEMMLOWP
	depends on BR2_PACKAGE_GTEST
	depends on BR2_PACKAGE_ABSEIL
	depends on BR2_PACKAGE_NEON2SSE
	depends on BR2_PACKAGE_FARMHASH
	depends on BR2_PACKAGE_FLATBUFFERS
	depends on BR2_PACKAGE_FFT2D
	help
          TensorFlow Lite is the official solution for running
          machine learning models on mobile and embedded devices.
          It enables on-device machine learning inference with
          low latency and a small binary size on Android, iOS,
          and other operating systems.

	  https://www.tensorflow.org/lite/

if BR2_PACKAGE_TENSORFLOW_LITE
config BR2_PACKAGE_TENSORFLOW_LITE_MICRO
	bool "TensorFlow Lite micro build"
	help
	  Build the micro version of TensorFlow Lite instead of the full version
comment "TESTING is disabled for micro building"
	depends on BR2_PACKAGE_TENSORFLOW_LITE_MICRO

config BR2_PACKAGE_TENSORFLOW_LITE_TESTING
	bool "Build and install testing binary"
	depends on !BR2_PACKAGE_TENSORFLOW_LITE_MICRO
	help
	  Build the tests and install them
endif
```
